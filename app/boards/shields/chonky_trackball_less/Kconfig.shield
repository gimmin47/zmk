## app/boards/shields/chonky_trackball_less/Kconfig.shield
```kconfig
# Copyright (c) 2020 Pete Johanson
# SPDX-License-Identifier: MIT

config SHIELD_CHONKY_TRACKBALL_LESS_LEFT
    def_bool $(shields_list_contains,chonky_trackball_less_left)

config SHIELD_CHONKY_TRACKBALL_LESS_RIGHT
    def_bool $(shields_list_contains,chonky_trackball_less_right)
```
