#include "chonky_trackball_less.dtsi"

/ {
   chosen {
      zephyr,display = &st7789;
  };

  mock_kscan: kscan_1 {
        compatible = "zmk,kscan-mock";
        columns = <0>;
        rows = <0>;
        events = <0>;
    };
};


/delete-node/ &kscan0;   // only required if the dongle uses a
                                // different board than the peripherals
